## boards/shields/revside/Kconfig.defconfig
```kconfig
# Copyright (c) 2021-2022 The ZMK Contributors
# SPDX-License-Identifier: MIT

if SHIELD_REVSIDE

config ZMK_KEYBOARD_NAME
    default "Revside"

endif
```

## config/boards/shields/revside/Kconfig.shield
```kconfig
# Copyright (c) 2021-2022 The ZMK Contributors
# SPDX-License-Identifier: MIT

config SHIELD_REVSIDE
    def_bool $(shields_list_contains,revside)
```
